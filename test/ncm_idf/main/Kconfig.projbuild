## test/ncm_idf/main/Kconfig.projbuild
```kconfig
menu "Example Configuration"
     config EXAMPLE_WEB_MOUNT_POINT
         string "Website mount point in VFS"
         default "/www"
         help
             Specify the mount point in VFS.
 

endmenu
```
